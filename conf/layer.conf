## conf/layer.conf
```bitbake
# We have a conf and classes directory, append to BBPATH
BBPATH .= ":${LAYERDIR}"

BBFILES += "${LAYERDIR}/recipes*/*/*.bb ${LAYERDIR}/recipes*/*/*.bbappend ${LAYERDIR}/images/*.bb"

BBFILE_COLLECTIONS += "meta-k3s-odroid-c2"
BBFILE_PATTERN_meta-k3s-odroid-c2 := "^${LAYERDIR}/"
BBFILE_PRIORITY_meta-k3s-odroid-c2 = "16"

LAYERSERIES_COMPAT_meta-k3s-odroid-c2 = "warrior"
```
